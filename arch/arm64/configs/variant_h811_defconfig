## arch/arm64/configs/variant_h811_defconfig
```kconfig
CONFIG_BUILD_ARM64_APPENDED_DTB_IMAGE_NAMES="msm8992-p1_tmo_us-rev-a msm8992-p1_tmo_us-rev-b msm8992-p1_tmo_us-rev-c msm8992-p1_tmo_us-rev-10"
CONFIG_LG_VPN_V33=y
CONFIG_VPNCLIENT_SECURITY=y
CONFIG_VPNCLIENT_PROC_UID=1000
CONFIG_VPNCLIENT_PROC_GID=1000
CONFIG_LG_VPN_V34=y
CONFIG_MACH_MSM8992_P1_TMO_US=y
CONFIG_LGE_QFPROM_SECHASH="cd6d4fa8f69d3bc7f4342f5209e93e12b9b1f44c42fad5d63631cf9ea3dadc2c"
CONFIG_CRYPTO_DEV_HWCRYPTO_FOR_SDCARD=y
CONFIG_FIPS_ENABLE=y
CONFIG_FIPS_RECOMPILE=y
```

## arch/arm64/configs/variant_h815_defconfig
```kconfig
CONFIG_BUILD_ARM64_APPENDED_DTB_IMAGE_NAMES="msm8992-p1_global_com-rev-a msm8992-p1_global_com-rev-b msm8992-p1_global_com-rev-c msm8992-p1_global_com-rev-10"
CONFIG_TOUCHSCREEN_LGE_SIC=y
CONFIG_TOUCHSCREEN_SIC_FW_PATH="p1"
CONFIG_LGE_MMC_DYNAMIC_LOG=y
CONFIG_MACH_MSM8992_P1_GLOBAL_COM=y
CONFIG_LGE_QFPROM_SECHASH="01048fd7d1dfd846cd13b53584b692e66ac553616d452ab7e096e65aafdd25c7"
```
